// SPDX-License-Identifier: GPL-2.0-or-later OR MIT
// GWRT2 variant of JDCloud RE-CS-02 (same ipq6010 hardware, the 2.5G port sits on LAN1).
// compatible fallback chain: jdcloud,re-cs-02-gwrt2 -> jdcloud,re-cs-02 -> qcom,ipq6018

/dts-v1/;

#include "ipq6010-re-cs-02.dts"

/ {
	model = "JDCloud RE-CS-02 GWRT2";
	compatible = "jdcloud,re-cs-02-gwrt2", "jdcloud,re-cs-02", "qcom,ipq6018";
};

/* GWRT2 puts the QCA8081 2.5G PHY behind the jack labelled LAN1 and the
 * QCA8075 1G PHY behind WAN, the reverse of stock RE-CS-02.
 *
 * Only the labels move. The SoC side stays stock: switch port 5 keeps the
 * 2500base-x PHY on PCS uniphy1 and port 1 keeps psgmii on uniphy0. qca-ppe
 * reparents every port RCG to the PCS clock named by that port's
 * pcs-handle, and the GCC RCG behind port 1 only lists uniphy0 parents, so
 * moving phy-mode/pcs-handle onto port 1 makes PPE probe fail with
 * "failed to set port clock parents" (-EINVAL) and removes all netdevs.
 */
&swport1 {
	label = "wan";
};

&swport5 {
	label = "lan1";
};
